## CMakeLists.txt
```
cmake_minimum_required(VERSION 3.20.0)

find_package(Zephyr REQUIRED HINTS $ENV{ZEPHYR_BASE})
project(banknote_sensor)

target_sources(app PRIVATE
    src/main.c
    src/sample_queue.c
    src/processing.c
    src/monitoring.c
    src/sensor_handler.c
    src/sensor_sim.c
)
target_include_directories(app PRIVATE include)
```

## west.yml
```
manifest:
  remotes:
    - name: zephyrproject
      url-base: https://github.com/zephyrproject-rtos

  projects:
    - name: zephyr
      remote: zephyrproject
      revision: v3.6.0
      import: true

  self:
    path: app
```

## prj.conf
```kconfig
CONFIG_PRINTK=y
CONFIG_LOG=y
CONFIG_LOG_DEFAULT_LEVEL=3
CONFIG_RING_BUFFER=y
```

## src/main.c
```c
#include "processing.h"
#include "monitoring.h"
#include "sensor_handler.h"
#include "sensor_sim.h"

#include <zephyr/kernel.h>
#include <zephyr/logging/log.h>

#include <stdlib.h>

LOG_MODULE_REGISTER(app, LOG_LEVEL_INF);

int main(int argc, char** argv)
{
    processing_init();
    LOG_INF("Processing task running.");

    monitoring_init();
    LOG_INF("Monitoring task running.");

    sensor_handler_init();
    LOG_INF("Sensor handler task running.");

    LOG_INF("Waiting for samples...");

    sensors_sim_init();
    LOG_INF("Sensor simulation ready.");
    
    sensors_sim_start();

    return 0;
}
```

## include/monitoring.h
```c
#ifndef BANKNOTE_AUTH_MONITORING_H
#define BANKNOTE_AUTH_MONITORING_H

/**
 * Init monitoring
 */
void monitoring_init(void);

#endif
```

## include/processing.h
```c
#ifndef BANKNOTE_AUTH_PROCESSING_H
#define BANKNOTE_AUTH_PROCESSING_H

#include <zephyr/sys/atomic.h>

/**
 * Counter of successfully processed sample
 */
extern atomic_t g_processed_count;

/**
 * Init processing
 */
void processing_init(void);

#endif
```

## include/sample_queue.h
```c
#ifndef BANKNOTE_AUTH_SAMPLE_QUEUE_H
#define BANKNOTE_AUTH_SAMPLE_QUEUE_H

#include <zephyr/kernel.h>

/**
 * Queue size
 */
#define SAMPLE_Q_CAPACITY 16

/**
 * Message queue with fixed capacity
 */
extern struct k_msgq g_sample_q;

#endif
```

## include/sensor_handler.h
```c
#ifndef BANKNOTE_AUTH_SENSOR_HANDLER_H
#define BANKNOTE_AUTH_SENSOR_HANDLER_H

#include "types.h"

#include <zephyr/sys/atomic.h>

/**
 * Number of sample packets dropped at the queue form ISR.
 */
extern atomic_t g_dropped_pck_count;

/**
 * Number of formatted samples dropped at the queue from handler.
 */
extern atomic_t g_dropped_sample_count;

/**
 * Number of miscatch in simulated hardware memory.
 * (When handler try to read in sensor memory but failed)
 */
extern atomic_t g_failed_sensor_buf_read;

/**
 * Simulated ISR, non blocking function to simply signal that a sensor have
 * some data available in it's simulated hardware buffer
 */
void handler_isr(sensor_id_t sensor);

/**
 * Init sensor handler
 */
void sensor_handler_init(void);

#endif
```

## include/sensor_sim.h
```c
#ifndef BANKNOTE_AUTH_SENSOR_SIM_H
#define BANKNOTE_AUTH_SENSOR_SIM_H

#include "types.h"

/**
 * Init sensor simulation
 */
void sensors_sim_init(void);

/**
 * Start sensor simulation
 */
void sensors_sim_start(void);

/**
 * End sensor simulation
 */
void sensors_sim_stop(void);

/**
 * Extract sensoor sample data from simulated hardware buffer
 * @return 0 on success, 1 otherwise
 * @note typically provided by sensor driver
 * And typically cqlled after a data-ready interrupt.
 */
int sensor_driver_get_raw(sensor_id_t sensor, sample_value_t* out);

#endif
```

## include/types.h
```c
#ifndef BANKNOTE_AUTH_TYPES_H
#define BANKNOTE_AUTH_TYPES_H

#include <stdint.h>

/**
 * Sensor sample value type
 * 
 * Note: matching real VIS and UV sensors sample data.
 */
typedef uint16_t sample_value_t;

/**
 * Sensor ID
 */
typedef enum
{
    SENSOR_VIS = 1,
    SENSOR_UV = 2
} sensor_id_t;

/**
 * Sensor sample data
 */
typedef struct
{
    sensor_id_t     sensor;
    uint32_t        seq;
    int64_t         t_handled_ms;
    sample_value_t  value;
} sample_msg_t;

#endif
```

## src/monitoring.c
```c
#include "monitoring.h"
#include "processing.h"
#include "sensor_handler.h"

#include <zephyr/kernel.h>
#include <zephyr/logging/log.h>

LOG_MODULE_REGISTER(monitoring, LOG_LEVEL_INF);

/**
 * Monitoring loop
 */
static void monitoring_task(void* a, void* b, void* c)
{
    ARG_UNUSED(a);
    ARG_UNUSED(b);
    ARG_UNUSED(c);

    while (1)
    {
        k_sleep(K_SECONDS(1));

        LOG_INF("processed=%ld, samples dropped=%ld, sensor data packets dropped=%ld",
            (long)atomic_get(&g_processed_count),
            (long)atomic_get(&g_dropped_sample_count),
            (long)atomic_get(&g_dropped_pck_count));
    }
}

K_THREAD_DEFINE(monitoring_tid, 1536, monitoring_task, NULL, NULL, NULL, 3, 0, 0);

void monitoring_init(void)
{
    /* TODO: init monitoring */
}
```

## src/processing.c
```c
#include "processing.h"
#include "types.h"
#include "sample_queue.h"

#include <zephyr/kernel.h>
#include <zephyr/logging/log.h>

LOG_MODULE_REGISTER(processing, LOG_LEVEL_INF);

atomic_t g_processed_count;

static void processing_task(void* a, void* b, void *c)
{
    ARG_UNUSED(a);
    ARG_UNUSED(b);
    ARG_UNUSED(c);

    sample_msg_t msg;

    /* loop is not polling K_FOREVER sleep the current thread until data to get */
    while (1)
    {
        /* wait for incoming sample msg to process */
        (void)k_msgq_get(&g_sample_q, &msg, K_FOREVER);
        atomic_inc(&g_processed_count);
        
        /* TODO: actually process it */
    }
}

K_THREAD_DEFINE(processing_tid, 2048, processing_task, NULL, NULL, NULL, 2, 0, 0);

void processing_init(void)
{
    atomic_set(&g_processed_count, 0);
}
```

## src/sample_queue.c
```c
#include "sample_queue.h"
#include "types.h"

/* TODO: check if alignment matches sample_msg_t size when sample_value_t type is defined*/
K_MSGQ_DEFINE(g_sample_q, sizeof(sample_msg_t), SAMPLE_Q_CAPACITY, 4);
```

## src/sensor_handler.c
```c
#include "sensor_handler.h"
#include "sample_queue.h"
#include "sensor_sim.h"

#include <zephyr/kernel.h>
#include <zephyr/logging/log.h>

LOG_MODULE_REGISTER(sensor_handler, LOG_LEVEL_INF);

atomic_t g_dropped_pck_count;
atomic_t g_dropped_sample_count;
atomic_t g_failed_sensor_buf_read;

/**
 * Sensor signals queue
 * Filled by ISR registering an IRQ event
 */
K_MSGQ_DEFINE(pck_q, sizeof(sensor_id_t), 8, 4);

/**
 * Sequence counter
 */
static uint32_t seq_counter;

/**
 * Handling data packets from queue
 */
static void sensor_handler_task(void* a, void* b, void* c)
{
    ARG_UNUSED(a);
    ARG_UNUSED(b);
    ARG_UNUSED(c);

    sensor_id_t sid;
    sample_msg_t msg;
    sample_value_t raw_value;

    while (1)
    {
        /* wait for sample packets q to be filled from ISR */
        k_msgq_get(&pck_q, &sid, K_FOREVER);

        if (sensor_driver_get_raw(sid, &raw_value) == 0)
        {
            /* forge */
            msg.sensor =        sid;
            msg.value =         raw_value;
            msg.seq =           seq_counter++;
            msg.t_handled_ms = k_uptime_get();

            /* drop if queue full */
            if (k_msgq_put(&g_sample_q, &msg, K_NO_WAIT) != 0)
            {
                atomic_inc(&g_dropped_sample_count);
            }
        }
        else
        {
            /* failed to read memory potential time lost */
            atomic_inc(&g_failed_sensor_buf_read);
        }
    }
}

/**
 * Define higher priority thread, handling sensor data
 */
K_THREAD_DEFINE(sensor_handler_tid, 2048, sensor_handler_task, NULL, NULL, NULL, 1, 0, 0);

/**
 * Simulated ISR
 */
void handler_isr(sensor_id_t sensor)
{
    if (k_msgq_put(&pck_q, &sensor, K_NO_WAIT) != 0)
    {
        atomic_inc(&g_dropped_pck_count);
    }
}

void sensor_handler_init(void)
{
    seq_counter = 0;
    atomic_set(&g_dropped_pck_count, 0);
    atomic_set(&g_dropped_sample_count, 0);
    atomic_set(&g_failed_sensor_buf_read, 0);
}
```

## src/sensor_sim.c
```c
#include "sensor_sim.h"
#include "sensor_handler.h"

#include <zephyr/kernel.h>
#include <zephyr/logging/log.h>
#include <zephyr/sys/ring_buffer.h>

LOG_MODULE_REGISTER(sensor_sim, LOG_LEVEL_INF);

/* computer sensor simulated hardware buffer holding 16 samples  */
#define SENSOR_BUF_SIZE (16 * sizeof(sample_value_t))

/* simulated sensors hardware buffer */
RING_BUF_DECLARE(vis_buf, SENSOR_BUF_SIZE);
RING_BUF_DECLARE(uv_buf,  SENSOR_BUF_SIZE);

/* spin lock on simulated hardware buffers */
static struct k_spinlock vis_buf_lock;
static struct k_spinlock uv_buf_lock;

/**
 * Simulate sensor storing data in hardware buffer
 * Returns 1 if data was not written
 */
static int sensor_sample_emit(sensor_id_t id, const sample_value_t* raw)
{
    struct ring_buf* rbuf;
    struct k_spinlock* slock;

    if (id == SENSOR_VIS)
    {
        rbuf = &vis_buf;
        slock = &vis_buf_lock;
    }
    else if (id == SENSOR_UV)
    {
        rbuf = &uv_buf;
        slock = &uv_buf_lock;
    }
    else
    {
        /* sensor id not valid */
        return 1;
    }

    /* lock buf and write in ring buf (simulated hardware buffer) */
    k_spinlock_key_t skey = k_spin_lock(slock);
    uint32_t bwrote = ring_buf_put(rbuf, (const uint8_t*)raw, sizeof(sample_value_t));
    k_spin_unlock(slock, skey);

    /* checl written bytes */
    if (bwrote != sizeof(sample_value_t))
    {
        return 1;
    }

    /* IRQ SIMULATION */
    handler_isr(id);
    return 0;
}

/* sensors sampling timing */
#define VIS_SAMPLING_SPAN_MS    10
#define UV_SAMPLING_SPAN_MS     25

/* define kernel handlers and timers */
static void vis_sampling_evt(struct k_timer* t);
static void uv_sampling_evt(struct k_timer* t);
K_TIMER_DEFINE(vis_timer, vis_sampling_evt, NULL);
K_TIMER_DEFINE(uv_timer, uv_sampling_evt, NULL);

/* called when sensor should generate a sample */
static void vis_sampling_evt(struct k_timer* t)
{
    ARG_UNUSED(t);

    /* TODO: GENERATE VIS SENSOR SAMPLE */
    sample_value_t generated_vis_sample = 1;
    sensor_sample_emit(SENSOR_VIS, &generated_vis_sample);
}

static void uv_sampling_evt(struct k_timer* t)
{
    ARG_UNUSED(t);

    /* TODO: Generate UV SENSOR SAMPLE */
    sample_value_t generated_uv_sample = 1;
    sensor_sample_emit(SENSOR_UV, &generated_uv_sample);
}

/* sensor sim states */
void sensors_sim_init(void)
{
    /* TODO: init sensor simulation */
    ring_buf_reset(&vis_buf);
    ring_buf_reset(&uv_buf);
}

void sensors_sim_start(void)
{
    LOG_INF("Starting sensor simulation : VIS=%dms UV=%dms", VIS_SAMPLING_SPAN_MS, UV_SAMPLING_SPAN_MS);

    k_timer_start(&vis_timer, K_MSEC(VIS_SAMPLING_SPAN_MS), K_MSEC(VIS_SAMPLING_SPAN_MS));
    k_timer_start(&uv_timer, K_MSEC(UV_SAMPLING_SPAN_MS), K_MSEC(UV_SAMPLING_SPAN_MS));
}

void sensors_sim_stop(void)
{
    k_timer_stop(&vis_timer);
    k_timer_stop(&uv_timer);
    LOG_INF("Stopped sensor simulation.");
}

int sensor_driver_get_raw(sensor_id_t id, sample_value_t* out)
{
    struct ring_buf* rbuf;
    struct k_spinlock* slock;

    if (out == NULL)
    {
        return 1;
    }

    if (id == SENSOR_VIS)
    {
        rbuf = &vis_buf;
        slock = &vis_buf_lock;
    }
    else if (id == SENSOR_UV)
    {
        rbuf = &uv_buf;
        slock = &uv_buf_lock;
    }
    else
    {
        /* sensor id not valid */
        return 1;
    }

    
    /* lock buf and read in ring buf */
    k_spinlock_key_t skey = k_spin_lock(slock);
    uint32_t bread = ring_buf_get(rbuf, (uint8_t*)out, sizeof(sample_value_t));
    k_spin_unlock(slock, skey);

    /* check read bytes */
    if (bread != sizeof(sample_value_t))
    {
        return 1;
    }
    else
    {
        return 0;
    }
}
```
